## hcfw/package/hw/gpu/mali-g31-fbdev-64/Config.in
```kconfig
config BR2_PACKAGE_MALI_G31_FBDEV_64
	bool "mali-g31-fbdev-64"
	depends on BR2_aarch64
	select BR2_PACKAGE_HAS_LIBEGL
	select BR2_PACKAGE_HAS_LIBGLES
	select BR2_PACKAGE_HAS_LIBMALI

	help
	  64-bit user-space binary components for Mali Bifrost G31 GPU.

if BR2_PACKAGE_MALI_G31_FBDEV_64

config BR2_PACKAGE_PROVIDES_LIBEGL
	default "mali-g31-fbdev-64"

config BR2_PACKAGE_PROVIDES_LIBGLES
	default "mali-g31-fbdev-64"

config BR2_PACKAGE_PROVIDES_LIBMALI
	default "mali-g31-fbdev-64"

endif
```
