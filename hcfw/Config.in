## hcfw/Config.in
```kconfig
menu "Home-Cooked Firmware"

  menu "Hardware Support"
    comment "GPU"
    source "$BR2_EXTERNAL_HCFW_PATH/package/hw/gpu/mali-g31-fbdev/Config.in"
  endmenu

  menu "Runtimes"
    source "$BR2_EXTERNAL_HCFW_PATH/package/runtimes/lvgljs/Config.in"
    source "$BR2_EXTERNAL_HCFW_PATH/package/runtimes/quickjs_ng/Config.in"
    source "$BR2_EXTERNAL_HCFW_PATH/package/runtimes/txiki_js/Config.in"
    source "$BR2_EXTERNAL_HCFW_PATH/package/runtimes/wasm3/Config.in"
  endmenu

endmenu
```

## hcfw/configs/hcfw_rg35xx_plus_defconfig
```kconfig
BR2_arm=y
BR2_cortex_a53=y
BR2_KERNEL_HEADERS_VERSION=y
BR2_DEFAULT_KERNEL_VERSION="4.9.170"
BR2_PACKAGE_HOST_LINUX_HEADERS_CUSTOM_4_9=y
BR2_TOOLCHAIN_BUILDROOT_CXX=y
BR2_GCC_ENABLE_OPENMP=y
BR2_OPTIMIZE_S=y
BR2_ROOTFS_DEVICE_CREATION_DYNAMIC_EUDEV=y
BR2_SYSTEM_DEFAULT_PATH="/bin:/sbin:/usr/bin:/usr/sbin:/usr/local/bin:/usr/local/sbin"
BR2_ROOTFS_OVERLAY="$(BR2_EXTERNAL_HCFW_PATH)/board/allwinner/h700/anbernic-rg35xx-plus-2024/fsoverlay"
BR2_ROOTFS_POST_IMAGE_SCRIPT="$(BR2_EXTERNAL_HCFW_PATH)/board/allwinner/h700/anbernic-rg35xx-plus-2024/post-image.sh"
BR2_PACKAGE_DIRECTFB=y
# BR2_PACKAGE_DIRECTFB_LINUXINPUT is not set
# BR2_PACKAGE_DIRECTFB_KEYBOARD is not set
# BR2_PACKAGE_DIRECTFB_PS2MOUSE is not set
# BR2_PACKAGE_DIRECTFB_SERIALMOUSE is not set
# BR2_PACKAGE_DIRECTFB_TSLIB is not set
BR2_PACKAGE_DIRECTFB_TIFF=y
# BR2_PACKAGE_DIRECTFB_SVG is not set
BR2_PACKAGE_SDL=y
BR2_PACKAGE_SDL_GFX=y
BR2_PACKAGE_SDL_IMAGE=y
BR2_PACKAGE_SDL_MIXER=y
BR2_PACKAGE_SDL_NET=y
BR2_PACKAGE_SDL_SOUND=y
BR2_PACKAGE_SDL_TTF=y
BR2_PACKAGE_SDL2=y
BR2_PACKAGE_SDL2_DIRECTFB=y
BR2_PACKAGE_SDL2_OPENGLES=y
BR2_PACKAGE_SDL2_GFX=y
BR2_PACKAGE_SDL2_IMAGE=y
BR2_PACKAGE_SDL2_MIXER=y
BR2_PACKAGE_SDL2_NET=y
BR2_PACKAGE_SDL2_TTF=y
BR2_PACKAGE_OPENSSL=y
BR2_PACKAGE_SQLITE=y
BR2_PACKAGE_SQLITE_STAT4=y
BR2_PACKAGE_SQLITE_ENABLE_COLUMN_METADATA=y
BR2_PACKAGE_SQLITE_ENABLE_FTS3=y
BR2_PACKAGE_SQLITE_ENABLE_JSON1=y
BR2_PACKAGE_IMLIB2=y
BR2_PACKAGE_LIBDRM=y
BR2_PACKAGE_PANGO=y
BR2_PACKAGE_C_ARES=y
BR2_PACKAGE_LIBCURL=y
BR2_PACKAGE_NGHTTP2=y
BR2_PACKAGE_LIBUV=y
BR2_PACKAGE_FILE=y
BR2_PACKAGE_UTIL_LINUX_BINARIES=y
BR2_PACKAGE_NANO=y
BR2_TARGET_ROOTFS_EXT2=y
BR2_TARGET_ROOTFS_EXT2_3=y
BR2_TARGET_ROOTFS_EXT2_SIZE="512M"
# BR2_TARGET_ROOTFS_TAR is not set
BR2_PACKAGE_HOST_DOSFSTOOLS=y
BR2_PACKAGE_HOST_F2FS_TOOLS=y
BR2_PACKAGE_HOST_GENIMAGE=y
BR2_PACKAGE_HOST_KMOD=y
BR2_PACKAGE_HOST_MKPASSWD=y
BR2_PACKAGE_HOST_MTOOLS=y
BR2_PACKAGE_HOST_PYTHON3=y
BR2_PACKAGE_HOST_PYTHON3_BZIP2=y
BR2_PACKAGE_HOST_PYTHON3_SSL=y
BR2_PACKAGE_HOST_QEMU=y
BR2_PACKAGE_MALI_G31_FBDEV=y
BR2_PACKAGE_LVGLJS=y
BR2_PACKAGE_QUICKJS_NG=y
BR2_PACKAGE_TXIKI_JS=y
```

## hcfw/package/hw/gpu/mali-g31-fbdev/Config.in
```kconfig
config BR2_PACKAGE_MALI_G31_FBDEV
	bool "mali-g31-fbdev"
	depends on BR2_arm
	select BR2_PACKAGE_HAS_LIBEGL
	select BR2_PACKAGE_HAS_LIBGLES

	help
	  32-bit user-space binary components for Mali Bifrost G31 GPU.

if BR2_PACKAGE_MALI_G31_FBDEV

config BR2_PACKAGE_PROVIDES_LIBEGL
	default "mali-g31-fbdev"

config BR2_PACKAGE_PROVIDES_LIBGLES
	default "mali-g31-fbdev"

endif

comment "mali-g31-fbdev"
```

## hcfw/package/runtimes/lvgljs/Config.in
```kconfig
config BR2_PACKAGE_LVGLJS
	bool "lvgljs"

	help
		LVGL JavaScript runtime based on Txiki.js
```

## hcfw/package/runtimes/txiki_js/Config.in
```kconfig
config BR2_PACKAGE_TXIKI_JS
	bool "txiki-js"

	help
		JavaScript runtime for embedded devices.
```

## hcfw/package/runtimes/wasm3/Config.in
```kconfig
config BR2_PACKAGE_WASM3
	bool "wasm3"

	help
		Fast web assembly runtime and interpreter.

		https://github.com/wasm3/wasm3
```
